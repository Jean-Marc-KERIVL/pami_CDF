## sdkconfig.defaults
```kconfig
# Configuration ESP32 pour PAMI Robot ROS 2

# Processor
CONFIG_IDF_TARGET="esp32"

# Board
CONFIG_ESP32_DEFAULT_CPU_FREQ_240=y

# Memory
CONFIG_ESP32_USE_SPIRAM=y
CONFIG_SPIRAM_MODE_QUAD=y
CONFIG_SPIRAM_BANKSWITCH_ENABLE=y

# UART
CONFIG_ESP_CONSOLE_UART_NUM=0
CONFIG_ESP_CONSOLE_UART_BAUDRATE=115200

# I2C
CONFIG_FREERTOS_ISR_STACKSIZE=2048
CONFIG_FREERTOS_TASK_FUNCTION_WRAPPER=y

# GPIO / LEDC PWM
CONFIG_SOC_LEDC_SUPPORTED=y
CONFIG_SOC_LEDC_HAS_TIMER_SPECIFIC_MUX=y

# ROS 2 / micro-ROS Configuration
CONFIG_FREERTOS_MAX_TASK_NAME_LEN=32
CONFIG_FREERTOS_USE_TRACE_FACILITY=y
CONFIG_FREERTOS_GENERATE_RUN_TIME_STATS=y

# Security
CONFIG_MBEDTLS_HARDWARE_AES=y
CONFIG_MBEDTLS_HARDWARE_MPI=y
CONFIG_MBEDTLS_HARDWARE_SHA=y

# Logging
CONFIG_LOG_DEFAULT_LEVEL=3
CONFIG_LOG_COLORS=y

# Watchdog
CONFIG_ESP_TASK_WDT=y
CONFIG_ESP_TASK_WDT_TIMEOUT_S=10

# Performance
CONFIG_ESP32_PERF_LEVEL_DEFAULT=2
CONFIG_FREERTOS_USE_MINIMAL_IDLE_HOOK=y

# Power Management
CONFIG_PM_ENABLE=y
CONFIG_PM_DFS_INIT_AUTO=y

# Networking (pour micro-ROS DDS)
CONFIG_LWIP_DNS_SUPPORT_MDNS_QUERIES=y
CONFIG_LWIP_MDNS_RESPONDER=y

# Build
CONFIG_COMPILER_OPTIMIZATION_SIZE=y
CONFIG_COMPILER_OPTIMIZATION_ASSERTIONS_ENABLE=y
```
